## arch/arm64/kvm/Kconfig
```kconfig
# SPDX-License-Identifier: GPL-2.0
#
# KVM configuration
#

source "virt/lib/Kconfig"
source "virt/kvm/Kconfig"

menuconfig VIRTUALIZATION
	bool "Virtualization"
	help
	  Say Y here to get to see options for using your Linux host to run
	  other operating systems inside virtual machines (guests).
	  This option alone does not add any kernel code.

	  If you say N, all options in this submenu will be skipped and
	  disabled.

if VIRTUALIZATION

menuconfig KVM
	bool "Kernel-based Virtual Machine (KVM) support"
	depends on HAVE_KVM
	# for TASKSTATS/TASK_DELAY_ACCT:
	depends on NET && MULTIUSER
	select MMU_NOTIFIER
	select PREEMPT_NOTIFIERS
	select HAVE_KVM_CPU_RELAX_INTERCEPT
	select HAVE_KVM_ARCH_TLB_FLUSH_ALL
	select KVM_MMIO
	select KVM_GENERIC_DIRTYLOG_READ_PROTECT
	select SRCU
	select KVM_VFIO
	select HAVE_KVM_EVENTFD
	select HAVE_KVM_IRQFD
	select HAVE_KVM_MSI
	select HAVE_KVM_IRQCHIP
	select HAVE_KVM_IRQ_ROUTING
	select IRQ_BYPASS_MANAGER
	select HAVE_KVM_IRQ_BYPASS
	select HAVE_KVM_VCPU_RUN_PID_CHANGE
	select TASKSTATS
	select TASK_DELAY_ACCT
	help
	  Support hosting virtualized guest machines.

	  If unsure, say N.

config NVHE_EL2_DEBUG
	bool "Debug mode for non-VHE EL2 object"
	depends on KVM
	help
	  Say Y here to enable the debug mode for the non-VHE KVM EL2 object.
	  Failure reports will BUG() in the hypervisor. This is intended for
	  local EL2 hypervisor development.

	  If unsure, say N.

config KVM_S2MPU
	bool "Stage-2 Memory Protection Unit support"
	depends on KVM
	help
	  Support for the Stage-2 Memory Protection Unit (S2MPU) and Stream
	  Security Mapping Table (SSMT) devices in KVM. This allows the
	  hypervisor to restrict DMA access to its memory and the memory of
	  protected guests.

config TEST_KVM_S2MPU
	tristate "Test kernel module for S2MPU"
	depends on KVM_S2MPU
	help
	  Kernel module for kselftests that exercises the KVM S2MPU driver.

config KVM_ROCKCHIP_IOMMU
	bool "Rockchip IOMMU Support"
	depends on KVM
	help
	  Support for Rockchip IOMMU in KVM. This allows the hypervisor to
	  restrict DMA access to its memory and the memory of protected guests.

menuconfig KVM_ARM_HYP_DEBUG_UART
	bool "Hack up some basic UART functionality at EL2"

if KVM_ARM_HYP_DEBUG_UART

choice
	prompt "Development board"
	default KVM_ARM_HYP_DEBUG_UART_BOARD_QEMU

config KVM_ARM_HYP_DEBUG_UART_BOARD_QEMU
	bool "QEMU"

config KVM_ARM_HYP_DEBUG_UART_BOARD_ROCK_PI_4
	bool "Rock Pi 4"

config KVM_ARM_HYP_DEBUG_UART_BOARD_OTHER
	bool "other"

endchoice

choice
	prompt "UART driver"
	default KVM_ARM_HYP_DEBUG_UART_DRIVER_8250 if KVM_ARM_HYP_DEBUG_UART_BOARD_ROCK_PI_4
	default KVM_ARM_HYP_DEBUG_UART_DRIVER_PL011

config KVM_ARM_HYP_DEBUG_UART_DRIVER_PL011
	bool "pl011"

config KVM_ARM_HYP_DEBUG_UART_DRIVER_8250
	bool "8250"

endchoice

config KVM_ARM_HYP_DEBUG_UART_ADDR
	hex "Physical address of the PL011 for EL2 to use"
	default 0xff1a0000 if KVM_ARM_HYP_DEBUG_UART_BOARD_ROCK_PI_4
	default 0x09000000

endif # KVM_ARM_HYP_DEBUG_UART

endif # VIRTUALIZATION
```
